## kbuild/kconfig.html
```kconfig
<!DOCTYPE html>

<html lang="en" data-content_root="../">
  <head>
    <meta charset="utf-8" />
    <meta name="viewport" content="width=device-width, initial-scale=1.0" /><meta name="viewport" content="width=device-width, initial-scale=1" />

    <title>Configuration targets and editors &#8212; The Linux Kernel  documentation</title>
    <link rel="stylesheet" type="text/css" href="../_static/pygments.css?v=03e43079" />
    <link rel="stylesheet" type="text/css" href="../_static/basic_mod.css?v=9b2032db" />
    <script src="../_static/documentation_options.js?v=5929fcd5"></script>
    <script src="../_static/doctools.js?v=9bcbadda"></script>
    <script src="../_static/sphinx_highlight.js?v=dc90522c"></script>
    <script src="../_static/js/theme.js"></script>
    <script src="../_static/js/petite-vue.js"></script>
    <link rel="index" title="Index" href="../genindex.html" />
    <link rel="search" title="Search" href="../search.html" />
    <link rel="next" title="Linux Kernel Makefiles" href="makefiles.html" />
    <link rel="prev" title="Kbuild" href="kbuild.html" /> 
  </head><body data-dark_mode_code_blocks="true">

<div id="top_nav">
    

    <nav>
        
            
        

        <p id="toggle_sidebar">
            <a href="#" title="Toggle sidebar">|||</a>
        </p>
        <h1><a href="../index.html" title="Go to homepage"><img src="../_static/logo.svg"/></a></h1>

        <a id="mode_toggle" href="#" @click.prevent="handleClick" :title="mode">
    <template v-if="mode == 'light'">
        <svg width="100%" height="100%" viewBox="0 0 79 80" version="1.1" xmlns="http://www.w3.org/2000/svg" xmlns:xlink="http://www.w3.org/1999/xlink" xml:space="preserve" style="fill-rule:evenodd;clip-rule:evenodd;stroke-linejoin:round;stroke-miterlimit:2;"><g id="mode_light"><rect id="Bounds" x="0" y="-0" width="78.623" height="79.049" style="fill:none;"/><circle cx="39.311" cy="39.524" r="15.734" style="fill:#fff;"/><g id="beams"><g id="beam"><path id="beam1" serif:id="beam" d="M44.212,4.901c0,-2.705 -2.196,-4.901 -4.901,-4.901c-2.704,-0 -4.9,2.196 -4.9,4.901l-0,9.614c-0,2.705 2.196,4.901 4.9,4.901c2.705,0 4.901,-2.196 4.901,-4.901l0,-9.614Z" style="fill:#fff;"/></g><g id="beam2" serif:id="beam"><path id="beam3" serif:id="beam" d="M67.48,18.073c1.913,-1.912 1.913,-5.018 0,-6.931c-1.912,-1.912 -5.018,-1.912 -6.931,0l-6.798,6.799c-1.912,1.912 -1.912,5.018 0,6.931c1.913,1.912 5.018,1.912 6.931,-0l6.798,-6.799Z" style="fill:#fff;"/></g><g id="beam4" serif:id="beam"><path id="beam5" serif:id="beam" d="M25.728,61.108c1.912,-1.913 1.912,-5.018 -0,-6.931c-1.913,-1.913 -5.019,-1.913 -6.931,-0l-6.799,6.798c-1.912,1.913 -1.912,5.019 0,6.931c1.913,1.913 5.019,1.913 6.931,0l6.799,-6.798Z" style="fill:#fff;"/></g><g id="beam6" serif:id="beam"><path id="beam7" serif:id="beam" d="M60.682,54.177c-1.913,-1.913 -5.018,-1.913 -6.931,-0c-1.912,1.913 -1.912,5.018 0,6.931l6.798,6.798c1.913,1.913 5.019,1.913 6.931,0c1.913,-1.912 1.913,-5.018 0,-6.931l-6.798,-6.798Z" style="fill:#fff;"/></g><g id="beam8" serif:id="beam"><path id="beam9" serif:id="beam" d="M4.901,34.623c-2.705,0 -4.901,2.196 -4.901,4.901c0,2.705 2.196,4.901 4.901,4.901l9.614,0c2.705,0 4.901,-2.196 4.901,-4.901c0,-2.705 -2.196,-4.901 -4.901,-4.901l-9.614,0Z" style="fill:#fff;"/></g><g id="beam10" serif:id="beam"><path id="beam11" serif:id="beam" d="M44.212,64.534c0,-2.705 -2.196,-4.901 -4.901,-4.901c-2.704,-0 -4.9,2.196 -4.9,4.901l-0,9.614c-0,2.705 2.196,4.901 4.9,4.901c2.705,-0 4.901,-2.196 4.901,-4.901l0,-9.614Z" style="fill:#fff;"/></g><g id="beam12" serif:id="beam"><path id="beam13" serif:id="beam" d="M18.929,11.142c-1.912,-1.912 -5.018,-1.912 -6.931,0c-1.912,1.913 -1.912,5.019 0,6.931l6.799,6.799c1.912,1.912 5.018,1.912 6.931,-0c1.912,-1.913 1.912,-5.019 -0,-6.931l-6.799,-6.799Z" style="fill:#fff;"/></g><g id="beam14" serif:id="beam"><path id="beam15" serif:id="beam" d="M64.108,34.623c-2.705,0 -4.901,2.196 -4.901,4.901c-0,2.705 2.196,4.901 4.901,4.901l9.614,0c2.705,0 4.901,-2.196 4.901,-4.901c-0,-2.705 -2.196,-4.901 -4.901,-4.901l-9.614,0Z" style="fill:#fff;"/></g></g></g></svg>
    </template>

    <template v-if="mode == 'dark'">
        <svg width="100%" height="100%" viewBox="0 0 79 80" version="1.1" xmlns="http://www.w3.org/2000/svg" xmlns:xlink="http://www.w3.org/1999/xlink" xml:space="preserve" style="fill-rule:evenodd;clip-rule:evenodd;stroke-linejoin:round;stroke-miterlimit:2;"><g id="mode_dark"><rect id="Bounds" x="0" y="-0" width="78.623" height="79.049" style="fill:none;"/><circle cx="39.311" cy="39.524" r="15.734" style="fill:#fff;"/><g id="beams"><g id="beam"><path id="beam1" serif:id="beam" d="M44.212,14.515c0,-2.705 -2.196,-4.901 -4.901,-4.901c-2.704,0 -4.901,2.196 -4.901,4.901c0,2.705 2.197,4.901 4.901,4.901c2.705,0 4.901,-2.196 4.901,-4.901Z" style="fill:#fff;"/></g><g id="beam2" serif:id="beam"><path id="beam3" serif:id="beam" d="M60.662,24.892c1.902,-1.902 1.902,-4.99 0,-6.892l-0.04,-0.039c-1.901,-1.902 -4.989,-1.902 -6.891,-0c-1.901,1.901 -1.901,4.989 0,6.891l0.04,0.04c1.902,1.901 4.989,1.901 6.891,-0Z" style="fill:#fff;"/></g><g id="beam4" serif:id="beam"><path id="beam5" serif:id="beam" d="M25.732,61.103c1.91,-1.91 1.91,-5.011 0,-6.921l-0.009,-0.01c-1.91,-1.91 -5.012,-1.91 -6.921,-0c-1.91,1.91 -1.91,5.011 -0,6.921l0.01,0.01c1.909,1.91 5.011,1.91 6.92,-0Z" style="fill:#fff;"/></g><g id="beam6" serif:id="beam"><path id="beam7" serif:id="beam" d="M60.672,54.167c-1.907,-1.907 -5.004,-1.907 -6.911,0l-0.02,0.02c-1.907,1.907 -1.907,5.004 0,6.911c1.907,1.907 5.004,1.907 6.911,-0l0.02,-0.02c1.907,-1.907 1.907,-5.004 0,-6.911Z" style="fill:#fff;"/></g><g id="beam8" serif:id="beam"><path id="beam9" serif:id="beam" d="M14.52,34.623c-2.702,0 -4.896,2.194 -4.896,4.896l0,0.01c0,2.702 2.194,4.896 4.896,4.896c2.702,0 4.896,-2.194 4.896,-4.896l-0,-0.01c-0,-2.702 -2.194,-4.896 -4.896,-4.896Z" style="fill:#fff;"/></g><g id="beam10" serif:id="beam"><path id="beam11" serif:id="beam" d="M44.212,64.534c0,-2.705 -2.196,-4.901 -4.901,-4.901c-2.704,-0 -4.901,2.196 -4.901,4.901c0,2.704 2.197,4.9 4.901,4.9c2.705,0 4.901,-2.196 4.901,-4.9Z" style="fill:#fff;"/></g><g id="beam12" serif:id="beam"><path id="beam13" serif:id="beam" d="M25.73,17.943c-1.911,-1.911 -5.015,-1.911 -6.926,0l-0.005,0.005c-1.911,1.911 -1.911,5.015 0,6.926c1.911,1.911 5.015,1.911 6.926,0l0.005,-0.005c1.911,-1.911 1.911,-5.014 -0,-6.926Z" style="fill:#fff;"/></g><g id="beam14" serif:id="beam"><path id="beam15" serif:id="beam" d="M64.098,34.623c-2.699,0 -4.891,2.192 -4.891,4.892l-0,0.019c-0,2.699 2.192,4.891 4.891,4.891c2.7,0 4.892,-2.192 4.892,-4.891l0,-0.019c0,-2.7 -2.192,-4.892 -4.892,-4.892Z" style="fill:#fff;"/></g></g></g></svg>
    </template>

    <template v-if="mode == 'darkest'">
        <svg width="100%" height="100%" viewBox="0 0 79 80" version="1.1" xmlns="http://www.w3.org/2000/svg" xmlns:xlink="http://www.w3.org/1999/xlink" xml:space="preserve" style="fill-rule:evenodd;clip-rule:evenodd;stroke-linejoin:round;stroke-miterlimit:2;"><g id="mode_darkest"><rect id="Bounds" x="0" y="-0" width="78.623" height="79.049" style="fill:none;"/><path d="M39.315,23.791c8.684,-0 15.734,7.05 15.734,15.733c0,8.684 -7.05,15.734 -15.734,15.734c-8.683,0 -15.733,-7.05 -15.733,-15.734c-0,-8.683 7.05,-15.733 15.733,-15.733Zm0,4.737c6.069,0 10.997,4.927 10.997,10.996c-0,6.069 -4.928,10.996 -10.997,10.996c-6.068,0 -10.996,-4.927 -10.996,-10.996c0,-6.069 4.928,-10.996 10.996,-10.996Z" style="fill:#fff;"/><g id="beams"><g id="beam"><path id="beam1" serif:id="beam" d="M44.216,14.515c0,-2.705 -2.196,-4.901 -4.901,-4.901c-2.704,0 -4.9,2.196 -4.9,4.901c-0,2.705 2.196,4.901 4.9,4.901c2.705,0 4.901,-2.196 4.901,-4.901Z" style="fill:#fff;"/></g><g id="beam2" serif:id="beam"><path id="beam3" serif:id="beam" d="M60.666,24.892c1.902,-1.902 1.902,-4.99 0,-6.892l-0.04,-0.039c-1.901,-1.902 -4.989,-1.902 -6.891,-0c-1.901,1.901 -1.901,4.989 0,6.891l0.04,0.04c1.902,1.901 4.99,1.901 6.891,-0Z" style="fill:#fff;"/></g><g id="beam4" serif:id="beam"><path id="beam5" serif:id="beam" d="M25.737,61.103c1.909,-1.91 1.909,-5.011 -0,-6.921l-0.01,-0.01c-1.91,-1.91 -5.011,-1.91 -6.921,-0c-1.91,1.91 -1.91,5.011 -0,6.921l0.01,0.01c1.91,1.91 5.011,1.91 6.921,-0Z" style="fill:#fff;"/></g><g id="beam6" serif:id="beam"><path id="beam7" serif:id="beam" d="M60.676,54.167c-1.907,-1.907 -5.004,-1.907 -6.911,0l-0.02,0.02c-1.907,1.907 -1.907,5.004 0,6.911c1.907,1.907 5.004,1.907 6.911,-0l0.02,-0.02c1.907,-1.907 1.907,-5.004 0,-6.911Z" style="fill:#fff;"/></g><g id="beam8" serif:id="beam"><path id="beam9" serif:id="beam" d="M14.524,34.623c-2.702,0 -4.896,2.194 -4.896,4.896l0,0.01c0,2.702 2.194,4.896 4.896,4.896c2.702,0 4.896,-2.194 4.896,-4.896l0,-0.01c0,-2.702 -2.194,-4.896 -4.896,-4.896Z" style="fill:#fff;"/></g><g id="beam10" serif:id="beam"><path id="beam11" serif:id="beam" d="M44.216,64.534c0,-2.705 -2.196,-4.901 -4.901,-4.901c-2.704,-0 -4.9,2.196 -4.9,4.901c-0,2.704 2.196,4.9 4.9,4.9c2.705,0 4.901,-2.196 4.901,-4.9Z" style="fill:#fff;"/></g><g id="beam12" serif:id="beam"><path id="beam13" serif:id="beam" d="M25.734,17.943c-1.911,-1.911 -5.015,-1.911 -6.926,0l-0.005,0.005c-1.911,1.911 -1.911,5.015 0,6.926c1.911,1.911 5.015,1.911 6.926,0l0.005,-0.005c1.911,-1.911 1.911,-5.014 0,-6.926Z" style="fill:#fff;"/></g><g id="beam14" serif:id="beam"><path id="beam15" serif:id="beam" d="M64.103,34.623c-2.7,0 -4.892,2.192 -4.892,4.892l-0,0.019c-0,2.699 2.192,4.891 4.892,4.891c2.699,0 4.891,-2.192 4.891,-4.891l0,-0.019c0,-2.7 -2.192,-4.892 -4.891,-4.892Z" style="fill:#fff;"/></g></g></g></svg>
    </template>
</a>

<script>
(function() {
    const LOCAL_STORAGE_KEY = 'piccoloThemeMode'

    var initialMode = localStorage.getItem(LOCAL_STORAGE_KEY)

    if (initialMode) {
        // Make sure the value in local storage is valid
        if (['light', 'dark', 'darkest'].indexOf(initialMode) == -1) {
            initialMode = 'light'
            localStorage.setItem(LOCAL_STORAGE_KEY, initialMode)
        }
    } else {
        // Check if the client prefers dark mode
        if (window.matchMedia && window.matchMedia('(prefers-color-scheme: dark)').matches) {
            initialMode = 'dark'
        } else {
            initialMode = 'light'
        }
        localStorage.setItem(LOCAL_STORAGE_KEY, initialMode)
    }

    document.documentElement.dataset.mode = initialMode

    PetiteVue.createApp({
        'mode': initialMode,
        handleClick() {
            let currentMode = this.mode

            if (currentMode == 'light') {
                this.mode = 'dark'
            } else if (currentMode == 'dark') {
                this.mode = 'darkest'
            } else if (currentMode == 'darkest') {
                this.mode = 'light'
            }

            document.documentElement.dataset.mode = this.mode
            localStorage.setItem(LOCAL_STORAGE_KEY, this.mode)

            console.log(this.mode)
        }
    }).mount('#mode_toggle')
})()
</script>
            <p class="mobile_search_link">
                <a href="../search.html" title="Search">
                    <svg xmlns="http://www.w3.org/2000/svg" viewBox="0 0 65 64" fill-rule="evenodd" stroke-linejoin="round" stroke-miterlimit="2">
                        <path d="M14.873 40.009c-2.315-3.943-3.642-8.532-3.642-13.429C11.231 11.91 23.141 0 37.811 0s26.58 11.91 26.58 26.58-11.91 26.58-26.58 26.58a26.44 26.44 0 0 1-14.277-4.161L9.739 62.794a3.12 3.12 0 0 1-4.413 0L.913 58.382c-1.217-1.218-1.217-3.196 0-4.413l13.96-13.96zM37.811 8.054c10.225 0 18.526 8.301 18.526 18.526s-8.301 18.526-18.526 18.526-18.526-8.301-18.526-18.526S27.586 8.054 37.811 8.054z" fill="#fff" />
                    </svg>
                </a>
            </p>
        

        <div class="searchbox_wrapper">
            
<search id="searchbox" style="display: none" role="search">
  <h3 id="searchlabel">Quick search</h3>
    <div class="searchformwrapper">
    <form class="search" action="../search.html" method="get">
      <input type="text" name="q" aria-labelledby="searchlabel" autocomplete="off" autocorrect="off" autocapitalize="off" spellcheck="false"/>
      <input type="submit" value="Go" />
    </form>
    </div>
</search>
<script>document.getElementById('searchbox').style.display = "block"</script>
        </div>
    </nav>
</div>

    
      <div class="sphinxsidebar" role="navigation" aria-label="Main">
        <div class="sphinxsidebarwrapper">
<search id="searchbox" style="display: none" role="search">
  <h3 id="searchlabel">Quick search</h3>
    <div class="searchformwrapper">
    <form class="search" action="../search.html" method="get">
      <input type="text" name="q" aria-labelledby="searchlabel" autocomplete="off" autocorrect="off" autocapitalize="off" spellcheck="false"/>
      <input type="submit" value="Go" />
    </form>
    </div>
</search>
<script>document.getElementById('searchbox').style.display = "block"</script><!-- SPDX-License-Identifier: GPL-2.0 -->

<p>
<h3 class="kernel-toc-contents">Contents</h3>
<input type="checkbox" class="kernel-toc-toggle" id = "kernel-toc-toggle" checked>
<label class="kernel-toc-title" for="kernel-toc-toggle"></label>

<div class="kerneltoc" id="kerneltoc">
<ul>
<li class="toctree-l1"><a class="reference internal" href="../process/development-process.html">Development process</a></li>
<li class="toctree-l1"><a class="reference internal" href="../process/submitting-patches.html">Submitting patches</a></li>
<li class="toctree-l1"><a class="reference internal" href="../process/code-of-conduct.html">Code of conduct</a></li>
<li class="toctree-l1"><a class="reference internal" href="../maintainer/index.html">Maintainer handbook</a></li>
<li class="toctree-l1"><a class="reference internal" href="../process/index.html">All development-process docs</a></li>
</ul>
<ul>
<li class="toctree-l1"><a class="reference internal" href="../core-api/index.html">Core API</a></li>
<li class="toctree-l1"><a class="reference internal" href="../driver-api/index.html">Driver APIs</a></li>
<li class="toctree-l1"><a class="reference internal" href="../subsystem-apis.html">Subsystems</a></li>
<li class="toctree-l1"><a class="reference internal" href="../locking/index.html">Locking</a></li>
</ul>
<ul>
<li class="toctree-l1"><a class="reference internal" href="../process/license-rules.html">Licensing rules</a></li>
<li class="toctree-l1"><a class="reference internal" href="../doc-guide/index.html">Writing documentation</a></li>
<li class="toctree-l1"><a class="reference internal" href="../dev-tools/index.html">Development tools</a></li>
<li class="toctree-l1"><a class="reference internal" href="../dev-tools/testing-overview.html">Testing guide</a></li>
<li class="toctree-l1"><a class="reference internal" href="../kernel-hacking/index.html">Hacking guide</a></li>
<li class="toctree-l1"><a class="reference internal" href="../trace/index.html">Tracing</a></li>
<li class="toctree-l1"><a class="reference internal" href="../fault-injection/index.html">Fault injection</a></li>
<li class="toctree-l1"><a class="reference internal" href="../livepatch/index.html">Livepatching</a></li>
<li class="toctree-l1"><a class="reference internal" href="../rust/index.html">Rust</a></li>
</ul>
<ul class="current">
<li class="toctree-l1"><a class="reference internal" href="../admin-guide/index.html">Administration</a></li>
<li class="toctree-l1 current"><a class="reference internal" href="index.html">Build system</a><ul class="current">
<li class="toctree-l2"><a class="reference internal" href="kconfig-language.html">Kconfig Language</a></li>
<li class="toctree-l2"><a class="reference internal" href="kconfig-macro-language.html">Kconfig macro language</a></li>
<li class="toctree-l2"><a class="reference internal" href="kbuild.html">Kbuild</a></li>
<li class="toctree-l2 current"><a class="current reference internal" href="#">Configuration targets and editors</a><ul>
<li class="toctree-l3"><a class="reference internal" href="#general">General</a></li>
<li class="toctree-l3"><a class="reference internal" href="#environment-variables">Environment variables</a></li>
<li class="toctree-l3"><a class="reference internal" href="#menuconfig">menuconfig</a></li>
<li class="toctree-l3"><a class="reference internal" href="#nconfig">nconfig</a></li>
<li class="toctree-l3"><a class="reference internal" href="#xconfig">xconfig</a></li>
<li class="toctree-l3"><a class="reference internal" href="#gconfig">gconfig</a></li>
</ul>
</li>
<li class="toctree-l2"><a class="reference internal" href="makefiles.html">Linux Kernel Makefiles</a></li>
<li class="toctree-l2"><a class="reference internal" href="modules.html">Building External Modules</a></li>
<li class="toctree-l2"><a class="reference internal" href="headers_install.html">Exporting kernel headers for use by userspace</a></li>
<li class="toctree-l2"><a class="reference internal" href="issues.html">Recursion issues</a></li>
<li class="toctree-l2"><a class="reference internal" href="reproducible-builds.html">Reproducible builds</a></li>
<li class="toctree-l2"><a class="reference internal" href="gcc-plugins.html">GCC plugin infrastructure</a></li>
<li class="toctree-l2"><a class="reference internal" href="llvm.html">Building Linux with Clang/LLVM</a></li>
<li class="toctree-l2"><a class="reference internal" href="gendwarfksyms.html">DWARF module versioning</a></li>
<li class="toctree-l2"><a class="reference internal" href="bash-completion.html">Bash completion for Kbuild</a></li>
</ul>
</li>
<li class="toctree-l1"><a class="reference internal" href="../admin-guide/reporting-issues.html">Reporting issues</a></li>
<li class="toctree-l1"><a class="reference internal" href="../tools/index.html">Userspace tools</a></li>
<li class="toctree-l1"><a class="reference internal" href="../userspace-api/index.html">Userspace API</a></li>
</ul>
<ul>
<li class="toctree-l1"><a class="reference internal" href="../firmware-guide/index.html">Firmware</a></li>
<li class="toctree-l1"><a class="reference internal" href="../devicetree/index.html">Firmware and Devicetree</a></li>
</ul>
<ul>
<li class="toctree-l1"><a class="reference internal" href="../arch/index.html">CPU architectures</a></li>
</ul>
<ul>
<li class="toctree-l1"><a class="reference internal" href="../staging/index.html">Unsorted documentation</a></li>
</ul>
<ul>
<li class="toctree-l1"><a class="reference internal" href="../translations/index.html">Translations</a></li>
</ul>

</div>

<script type="text/javascript"> <!--
  var sbar = document.getElementsByClassName("sphinxsidebar")[0];
  let currents = document.getElementsByClassName("current")
  if (currents.length) {
    sbar.scrollTop = currents[currents.length - 1].offsetTop;
  }
  --> </script>
  <div role="note" aria-label="source link">
    <h3>This Page</h3>
    <ul class="this-page-menu">
      <li><a href="../_sources/kbuild/kconfig.rst.txt"
            rel="nofollow">Show Source</a></li>
    </ul>
   </div>
        </div>
      </div>


    <div class="document">
      <div class="documentwrapper">
        <div class="bodywrapper">
          <div class="body" role="main">
            
  <!-- SPDX-License-Identifier: GPL-2.0 -->
<!-- Copyright © 2023, Oracle and/or its affiliates. -->



<div class="language-selection">
English

<ul>

<li><a href="../translations/zh_CN/kbuild/kconfig.html">Chinese (Simplified)</a></li>

</ul>
</div>
<section id="configuration-targets-and-editors">
<h1>Configuration targets and editors<a class="headerlink" href="#configuration-targets-and-editors" title="Link to this heading">¶</a></h1>
<p>This file contains some assistance for using <code class="docutils literal notranslate"><span class="pre">make</span> <span class="pre">*config</span></code>.</p>
<p>Use <code class="docutils literal notranslate"><span class="pre">make</span> <span class="pre">help</span></code> to list all of the possible configuration targets.</p>
<p>The xconfig (‘qconf’), menuconfig (‘mconf’), and nconfig (‘nconf’)
programs also have embedded help text.  Be sure to check that for
navigation, search, and other general help text.</p>
<p>The gconfig (‘gconf’) program has limited help text.</p>
<section id="general">
<h2>General<a class="headerlink" href="#general" title="Link to this heading">¶</a></h2>
<p>New kernel releases often introduce new config symbols.  Often more
important, new kernel releases may rename config symbols.  When
this happens, using a previously working .config file and running
“make oldconfig” won’t necessarily produce a working new kernel
for you, so you may find that you need to see what NEW kernel
symbols have been introduced.</p>
<p>To see a list of new config symbols, use:</p>
<div class="highlight-none notranslate"><div class="highlight"><pre><span></span>cp user/some/old.config .config
make listnewconfig
</pre></div>
</div>
<p>and the config program will list any new symbols, one per line.</p>
<p>Alternatively, you can use the brute force method:</p>
<div class="highlight-none notranslate"><div class="highlight"><pre><span></span>make oldconfig
scripts/diffconfig .config.old .config | less
</pre></div>
</div>
</section>
<section id="environment-variables">
<h2>Environment variables<a class="headerlink" href="#environment-variables" title="Link to this heading">¶</a></h2>
<p>Environment variables for <code class="docutils literal notranslate"><span class="pre">*config</span></code>:</p>
<dl class="simple">
<dt><code class="docutils literal notranslate"><span class="pre">KCONFIG_CONFIG</span></code></dt><dd><p>This environment variable can be used to specify a default kernel config
file name to override the default name of “.config”.</p>
</dd>
<dt><code class="docutils literal notranslate"><span class="pre">KCONFIG_DEFCONFIG_LIST</span></code></dt><dd><p>This environment variable specifies a list of config files which can be
used as a base configuration in case the .config does not exist yet.
Entries in the list are separated with whitespaces to each other, and
the first one that exists is used.</p>
</dd>
<dt><code class="docutils literal notranslate"><span class="pre">KCONFIG_OVERWRITECONFIG</span></code></dt><dd><p>If you set KCONFIG_OVERWRITECONFIG in the environment, Kconfig will not
break symlinks when .config is a symlink to somewhere else.</p>
</dd>
<dt><code class="docutils literal notranslate"><span class="pre">KCONFIG_WARN_UNKNOWN_SYMBOLS</span></code></dt><dd><p>This environment variable makes Kconfig warn about all unrecognized
symbols in the config input.</p>
</dd>
<dt><code class="docutils literal notranslate"><span class="pre">KCONFIG_WERROR</span></code></dt><dd><p>If set, Kconfig treats warnings as errors.</p>
</dd>
<dt><code class="docutils literal notranslate"><span class="pre">CONFIG_</span></code></dt><dd><p>If you set <code class="docutils literal notranslate"><span class="pre">CONFIG_</span></code> in the environment, Kconfig will prefix all symbols
with its value when saving the configuration, instead of using the
default, <code class="docutils literal notranslate"><span class="pre">CONFIG_</span></code>.</p>
</dd>
</dl>
<p>Environment variables for <code class="docutils literal notranslate"><span class="pre">{allyes/allmod/allno/rand}config</span></code>:</p>
<dl>
<dt><code class="docutils literal notranslate"><span class="pre">KCONFIG_ALLCONFIG</span></code></dt><dd><p>The allyesconfig/allmodconfig/allnoconfig/randconfig variants can also
use the environment variable KCONFIG_ALLCONFIG as a flag or a filename
that contains config symbols that the user requires to be set to a
specific value.  If KCONFIG_ALLCONFIG is used without a filename where
KCONFIG_ALLCONFIG == “” or KCONFIG_ALLCONFIG == “1”, <code class="docutils literal notranslate"><span class="pre">make</span> <span class="pre">*config</span></code>
checks for a file named “all{yes/mod/no/def/random}.config”
(corresponding to the <code class="docutils literal notranslate"><span class="pre">*config</span></code> command that was used) for symbol values
that are to be forced.  If this file is not found, it checks for a
file named “all.config” to contain forced values.</p>
<p>This enables you to create “miniature” config (miniconfig) or custom
config files containing just the config symbols that you are interested
in.  Then the kernel config system generates the full .config file,
including symbols of your miniconfig file.</p>
<p>This <code class="docutils literal notranslate"><span class="pre">KCONFIG_ALLCONFIG</span></code> file is a config file which contains
(usually a subset of all) preset config symbols.  These variable
settings are still subject to normal dependency checks.</p>
<p>Examples:</p>
<div class="highlight-none notranslate"><div class="highlight"><pre><span></span>KCONFIG_ALLCONFIG=custom-notebook.config make allnoconfig
</pre></div>
</div>
<p>or:</p>
<div class="highlight-none notranslate"><div class="highlight"><pre><span></span>KCONFIG_ALLCONFIG=mini.config make allnoconfig
</pre></div>
</div>
<p>or:</p>
<div class="highlight-none notranslate"><div class="highlight"><pre><span></span>make KCONFIG_ALLCONFIG=mini.config allnoconfig
</pre></div>
</div>
<p>These examples will disable most options (allnoconfig) but enable or
disable the options that are explicitly listed in the specified
mini-config files.</p>
</dd>
</dl>
<p>Environment variables for <code class="docutils literal notranslate"><span class="pre">randconfig</span></code>:</p>
<dl>
<dt><code class="docutils literal notranslate"><span class="pre">KCONFIG_SEED</span></code></dt><dd><p>You can set this to the integer value used to seed the RNG, if you want
to somehow debug the behaviour of the kconfig parser/frontends.
If not set, the current time will be used.</p>
</dd>
<dt><code class="docutils literal notranslate"><span class="pre">KCONFIG_PROBABILITY</span></code></dt><dd><p>This variable can be used to skew the probabilities. This variable can
be unset or empty, or set to three different formats:</p>
<table class="docutils align-default">
<thead>
<tr class="row-odd"><th class="head"><p>KCONFIG_PROBABILITY</p></th>
<th class="head"><p>y:n split</p></th>
<th class="head"><p>y:m:n split</p></th>
</tr>
</thead>
<tbody>
<tr class="row-even"><td><p>unset or empty</p></td>
<td><p>50  : 50</p></td>
<td><p>33  : 33  : 34</p></td>
</tr>
<tr class="row-odd"><td><p>N</p></td>
<td><p>N  : 100-N</p></td>
<td><p>N/2 : N/2 : 100-N</p></td>
</tr>
<tr class="row-even"><td><p>[1] N:M</p></td>
<td><p>N+M : 100-(N+M)</p></td>
<td><p>N  :  M  : 100-(N+M)</p></td>
</tr>
<tr class="row-odd"><td><p>[2] N:M:L</p></td>
<td><p>N  : 100-N</p></td>
<td><p>M  :  L  : 100-(M+L)</p></td>
</tr>
</tbody>
</table>
</dd>
</dl>
<p>where N, M and L are integers (in base 10) in the range [0,100], and so
that:</p>
<blockquote>
<div><p>[1] N+M is in the range [0,100]</p>
<p>[2] M+L is in the range [0,100]</p>
</div></blockquote>
<p>Examples:</p>
<div class="highlight-none notranslate"><div class="highlight"><pre><span></span>KCONFIG_PROBABILITY=10
    10% of booleans will be set to &#39;y&#39;, 90% to &#39;n&#39;
    5% of tristates will be set to &#39;y&#39;, 5% to &#39;m&#39;, 90% to &#39;n&#39;
KCONFIG_PROBABILITY=15:25
    40% of booleans will be set to &#39;y&#39;, 60% to &#39;n&#39;
    15% of tristates will be set to &#39;y&#39;, 25% to &#39;m&#39;, 60% to &#39;n&#39;
KCONFIG_PROBABILITY=10:15:15
    10% of booleans will be set to &#39;y&#39;, 90% to &#39;n&#39;
    15% of tristates will be set to &#39;y&#39;, 15% to &#39;m&#39;, 70% to &#39;n&#39;
</pre></div>
</div>
<p>Environment variables for <code class="docutils literal notranslate"><span class="pre">syncconfig</span></code>:</p>
<dl class="simple">
<dt><code class="docutils literal notranslate"><span class="pre">KCONFIG_NOSILENTUPDATE</span></code></dt><dd><p>If this variable has a non-blank value, it prevents silent kernel
config updates (requires explicit updates).</p>
</dd>
<dt><code class="docutils literal notranslate"><span class="pre">KCONFIG_AUTOCONFIG</span></code></dt><dd><p>This environment variable can be set to specify the path &amp; name of the
“auto.conf” file.  Its default value is “include/config/auto.conf”.</p>
</dd>
<dt><code class="docutils literal notranslate"><span class="pre">KCONFIG_AUTOHEADER</span></code></dt><dd><p>This environment variable can be set to specify the path &amp; name of the
“autoconf.h” (header) file.
Its default value is “include/generated/autoconf.h”.</p>
</dd>
</dl>
</section>
<section id="menuconfig">
<h2>menuconfig<a class="headerlink" href="#menuconfig" title="Link to this heading">¶</a></h2>
<p>Searching in menuconfig:</p>
<blockquote>
<div><p>The Search function searches for kernel configuration symbol
names, so you have to know something close to what you are
looking for.</p>
<p>Example:</p>
<div class="highlight-none notranslate"><div class="highlight"><pre><span></span>/hotplug
This lists all config symbols that contain &quot;hotplug&quot;,
e.g., HOTPLUG_CPU, MEMORY_HOTPLUG.
</pre></div>
</div>
<p>For search help, enter / followed by TAB-TAB (to highlight
&lt;Help&gt;) and Enter.  This will tell you that you can also use
regular expressions (regexes) in the search string, so if you
are not interested in MEMORY_HOTPLUG, you could try:</p>
<div class="highlight-none notranslate"><div class="highlight"><pre><span></span>/^hotplug
</pre></div>
</div>
<p>When searching, symbols are sorted thus:</p>
<ul class="simple">
<li><p>first, exact matches, sorted alphabetically (an exact match
is when the search matches the complete symbol name);</p></li>
<li><p>then, other matches, sorted alphabetically.</p></li>
</ul>
<p>For example, ^ATH.K matches:</p>
<blockquote>
<div><p>ATH5K ATH9K ATH5K_AHB ATH5K_DEBUG [...] ATH6KL ATH6KL_DEBUG
[...] ATH9K_AHB ATH9K_BTCOEX_SUPPORT ATH9K_COMMON [...]</p>
</div></blockquote>
<p>of which only ATH5K and ATH9K match exactly and so are sorted
first (and in alphabetical order), then come all other symbols,
sorted in alphabetical order.</p>
<p>In this menu, pressing the key in the (#) prefix will jump
directly to that location. You will be returned to the current
search results after exiting this new menu.</p>
</div></blockquote>
<p>User interface options for ‘menuconfig’:</p>
<dl>
<dt><code class="docutils literal notranslate"><span class="pre">MENUCONFIG_COLOR</span></code></dt><dd><p>It is possible to select different color themes using the variable
MENUCONFIG_COLOR.  To select a theme use:</p>
<div class="highlight-none notranslate"><div class="highlight"><pre><span></span>make MENUCONFIG_COLOR=&lt;theme&gt; menuconfig
</pre></div>
</div>
<p>Available themes are:</p>
<div class="highlight-none notranslate"><div class="highlight"><pre><span></span>- mono       =&gt; selects colors suitable for monochrome displays
- blackbg    =&gt; selects a color scheme with black background
- classic    =&gt; theme with blue background. The classic look
- bluetitle  =&gt; a LCD friendly version of classic. (default)
</pre></div>
</div>
</dd>
<dt><code class="docutils literal notranslate"><span class="pre">MENUCONFIG_MODE</span></code></dt><dd><p>This mode shows all sub-menus in one large tree.</p>
<p>Example:</p>
<div class="highlight-none notranslate"><div class="highlight"><pre><span></span>make MENUCONFIG_MODE=single_menu menuconfig
</pre></div>
</div>
</dd>
</dl>
</section>
<section id="nconfig">
<h2>nconfig<a class="headerlink" href="#nconfig" title="Link to this heading">¶</a></h2>
<p>nconfig is an alternate text-based configurator.  It lists function
keys across the bottom of the terminal (window) that execute commands.
You can also just use the corresponding numeric key to execute the
commands unless you are in a data entry window.  E.g., instead of F6
for Save, you can just press 6.</p>
<p>Use F1 for Global help or F3 for the Short help menu.</p>
<p>Searching in nconfig:</p>
<blockquote>
<div><p>You can search either in the menu entry “prompt” strings
or in the configuration symbols.</p>
<p>Use / to begin a search through the menu entries.  This does
not support regular expressions.  Use &lt;Down&gt; or &lt;Up&gt; for
Next hit and Previous hit, respectively.  Use &lt;Esc&gt; to
terminate the search mode.</p>
<p>F8 (SymSearch) searches the configuration symbols for the
given string or regular expression (regex).</p>
<p>In the SymSearch, pressing the key in the (#) prefix will
jump directly to that location. You will be returned to the
current search results after exiting this new menu.</p>
</div></blockquote>
<p>Environment variables:</p>
<dl>
<dt><code class="docutils literal notranslate"><span class="pre">NCONFIG_MODE</span></code></dt><dd><p>This mode shows all sub-menus in one large tree.</p>
<p>Example:</p>
<div class="highlight-none notranslate"><div class="highlight"><pre><span></span>make NCONFIG_MODE=single_menu nconfig
</pre></div>
</div>
</dd>
</dl>
</section>
<section id="xconfig">
<h2>xconfig<a class="headerlink" href="#xconfig" title="Link to this heading">¶</a></h2>
<p>Searching in xconfig:</p>
<blockquote>
<div><p>The Search function searches for kernel configuration symbol
names, so you have to know something close to what you are
looking for.</p>
<p>Example:</p>
<div class="highlight-none notranslate"><div class="highlight"><pre><span></span>Ctrl-F hotplug
</pre></div>
</div>
<p>or:</p>
<div class="highlight-none notranslate"><div class="highlight"><pre><span></span>Menu: File, Search, hotplug
</pre></div>
</div>
<p>lists all config symbol entries that contain “hotplug” in
the symbol name.  In this Search dialog, you may change the
config setting for any of the entries that are not grayed out.
You can also enter a different search string without having
to return to the main menu.</p>
</div></blockquote>
</section>
<section id="gconfig">
<h2>gconfig<a class="headerlink" href="#gconfig" title="Link to this heading">¶</a></h2>
<p>Searching in gconfig:</p>
<blockquote>
<div><p>There is no search command in gconfig.  However, gconfig does
have several different viewing choices, modes, and options.</p>
</div></blockquote>
</section>
</section>


            <div class="clearer"></div>
          </div>
        </div>
      </div>
    
        <div id="show_right_sidebar">
            <p><a class="toggle_right_sidebar" href="#"><span class="icon">&lt;</span><span>Page contents</span></a></p>
        </div>

        <div id="right_sidebar">
            <p><a class="toggle_right_sidebar" href="#"><span class="icon">&gt;</span><span>Page contents:</span></a></p>
            <div class="page_toc">
                <ul>
<li><a class="reference internal" href="#">Configuration targets and editors</a><ul>
<li><a class="reference internal" href="#general">General</a></li>
<li><a class="reference internal" href="#environment-variables">Environment variables</a></li>
<li><a class="reference internal" href="#menuconfig">menuconfig</a></li>
<li><a class="reference internal" href="#nconfig">nconfig</a></li>
<li><a class="reference internal" href="#xconfig">xconfig</a></li>
<li><a class="reference internal" href="#gconfig">gconfig</a></li>
</ul>
</li>
</ul>

            </div>
        </div>
    

      <div class="clearer"></div>
    </div>
    <div class="button_nav_wrapper">
        <div class="button_nav">
            <div class="left">
                
                <a href="kbuild.html">
                    <span class="icon">&lt;</span><span>Kbuild</span></a>
                
            </div>

            <div class="right">
                
                    <a href="makefiles.html"><span>Linux Kernel Makefiles</span><span class="icon">&gt;</span></a>
                
            </div>
        </div>
    </div>


    <div class="footer" role="contentinfo">
    &#169; Copyright The kernel development community.
      Created using <a href="https://www.sphinx-doc.org/">Sphinx</a> 8.2.3.
    </div>

<p id="theme_credit">Styled using the <a href="https://github.com/piccolo-orm/piccolo_theme">Piccolo Theme</a></p>
  </body>
</html>
```
